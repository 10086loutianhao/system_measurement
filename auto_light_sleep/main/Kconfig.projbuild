## auto_light_sleep/main/Kconfig.projbuild
```kconfig
menu "Example Configuration"

    choice EXAMPLE_MAX_CPU_FREQ
        prompt "Maximum CPU frequency"
        default EXAMPLE_MAX_CPU_FREQ_80M
        depends on PM_ENABLE
        help
            Maximum CPU frequency to use for dynamic frequency scaling.

        config EXAMPLE_MAX_CPU_FREQ_48M
            bool "48 MHz"
            depends on IDF_TARGET_ESP32H2
        config EXAMPLE_MAX_CPU_FREQ_64M
            bool "64 MHz"
            depends on IDF_TARGET_ESP32H2
        config EXAMPLE_MAX_CPU_FREQ_80M
            bool "80 MHz"
            depends on !IDF_TARGET_ESP32H2
        config EXAMPLE_MAX_CPU_FREQ_96M
            bool "96 MHz"
            depends on IDF_TARGET_ESP32H2
        config EXAMPLE_MAX_CPU_FREQ_120M
            bool "120 MHz"
            depends on IDF_TARGET_ESP32C2
        config EXAMPLE_MAX_CPU_FREQ_160M
            bool "160 MHz"
            depends on (!IDF_TARGET_ESP32C2 && !IDF_TARGET_ESP32H2)
        config EXAMPLE_MAX_CPU_FREQ_240M
            bool "240 MHz"
            depends on IDF_TARGET_ESP32 || IDF_TARGET_ESP32S2 || IDF_TARGET_ESP32S3
    endchoice

    config EXAMPLE_MAX_CPU_FREQ_MHZ
        int
        default 48 if EXAMPLE_MAX_CPU_FREQ_48M
        default 64 if EXAMPLE_MAX_CPU_FREQ_64M
        default 80 if EXAMPLE_MAX_CPU_FREQ_80M
        default 96 if EXAMPLE_MAX_CPU_FREQ_96M
        default 120 if EXAMPLE_MAX_CPU_FREQ_120M
        default 160 if EXAMPLE_MAX_CPU_FREQ_160M
        default 240 if EXAMPLE_MAX_CPU_FREQ_240M

    choice EXAMPLE_MIN_CPU_FREQ
        prompt "Minimum CPU frequency"
        default EXAMPLE_MIN_CPU_FREQ_10M
        depends on PM_ENABLE
        help
            Minimum CPU frequency to use for dynamic frequency scaling.
            Should be set to XTAL frequency or XTAL frequency divided by integer.

        config EXAMPLE_MIN_CPU_FREQ_40M
            bool "40 MHz (use with 40MHz XTAL)"
            depends on XTAL_FREQ_40 || XTAL_FREQ_AUTO
        config EXAMPLE_MIN_CPU_FREQ_32M
            bool "32 MHz (use with 32MHz XTAL)"
            depends on XTAL_FREQ_32 || XTAL_FREQ_AUTO
        config EXAMPLE_MIN_CPU_FREQ_20M
            bool "20 MHz (use with 40MHz XTAL)"
            depends on XTAL_FREQ_40 || XTAL_FREQ_AUTO
        config EXAMPLE_MIN_CPU_FREQ_16M
            bool "16 MHz (use with 32MHz XTAL)"
            depends on XTAL_FREQ_32 || XTAL_FREQ_AUTO
        config EXAMPLE_MIN_CPU_FREQ_10M
            bool "10 MHz (use with 40MHz XTAL)"
            depends on XTAL_FREQ_40 || XTAL_FREQ_AUTO
        config EXAMPLE_MIN_CPU_FREQ_26M
            bool "26 MHz (use with 26MHz XTAL)"
            depends on XTAL_FREQ_26 || XTAL_FREQ_AUTO
        config EXAMPLE_MIN_CPU_FREQ_13M
            bool "13 MHz (use with 26MHz XTAL)"
            depends on XTAL_FREQ_26 || XTAL_FREQ_AUTO
        config EXAMPLE_MIN_CPU_FREQ_8M
            bool "8 MHz (use with 32MHz XTAL)"
            depends on XTAL_FREQ_32 || XTAL_FREQ_AUTO
    endchoice

    config EXAMPLE_MIN_CPU_FREQ_MHZ
        int
        default 40 if EXAMPLE_MIN_CPU_FREQ_40M
        default 32 if EXAMPLE_MIN_CPU_FREQ_32M
        default 20 if EXAMPLE_MIN_CPU_FREQ_20M
        default 16 if EXAMPLE_MIN_CPU_FREQ_16M
        default 10 if EXAMPLE_MIN_CPU_FREQ_10M
        default 26 if EXAMPLE_MIN_CPU_FREQ_26M
        default 13 if EXAMPLE_MIN_CPU_FREQ_13M
        default 8 if EXAMPLE_MIN_CPU_FREQ_8M

endmenu
```
